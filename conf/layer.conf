## conf/layer.conf
```bitbake
# We have a conf and classes directory, add to BBPATH
BBPATH .= ":${LAYERDIR}"

# We have recipes-* directories, add to BBFILES
BBFILES += "${LAYERDIR}/recipes-*/*/*.bb \
            ${LAYERDIR}/recipes-*/*/*.bbappend"

BBFILE_COLLECTIONS += "meta-sbarthelemy-test"
BBFILE_PATTERN_meta-sbarthelemy-test = "^${LAYERDIR}/"
BBFILE_PRIORITY_meta-sbarthelemy-test = "6"

LAYERDEPENDS_meta-sbarthelemy-test = "core"
LAYERSERIES_COMPAT_meta-sbarthelemy-test = "scarthgap"
```
